// SPDX-License-Identifier: BSD-3-Clause
/*
 * Copyright (c) 2021, Leandro Friedrich <email@leandrofriedrich.de>
 */

/dts-v1/;
#include "qcom-msm8974.dtsi"
#include "qcom-pm8941.dtsi"
/ {
	model = "Nokia Lumia 930";
	compatible = "nokia,martini", "qcom,msm8974";
};

&mmcc {
	status = "disabled";
};

&soc {
	sdhci@f9824900 {
		status = "ok";
		bus-width = <8>;
		non-removable;	
		pinctrl-names = "default";
	};
};
